## meta-local/conf/layer.conf
```bitbake
BBPATH .= ":${LAYERDIR}"
BBFILES += "${LAYERDIR}/recipes-*/*/*.bb ${LAYERDIR}/recipes-*/*/*.bbappend"
BBFILE_COLLECTIONS += "meta-local"
BBFILE_PATTERN_meta-local = "^${LAYERDIR}/"
BBFILE_PRIORITY_meta-local = "99"
LAYERSERIES_COMPAT_meta-local = "scarthgap"
```
